## qemu.defconfig
```kconfig
BR2_i386=y
BR2_x86_i686=y

BR2_TOOLCHAIN_BUILDROOT_VENDOR="ponyatov"

## toolchain

BR2_CCACHE=y
BR2_OPTIMIZE_FAST=y
#BR2_BINUTILS_VERSION_2_31_X=y
BR2_BINUTILS_VERSION_2_32_X=y
BR2_BINUTILS_EXTRA_CONFIG_OPTIONS="--disable-nls"
BR2_GCC_VERSION_8_X=y
BR2_EXTRA_GCC_CONFIG_OPTIONS="--disable-nls"
BR2_GCC_ENABLE_LTO=y
BR2_GCC_ENABLE_GRAPHITE=y

## change for release

BR2_TOOLCHAIN_BUILDROOT_WCHAR=n
BR2_TOOLCHAIN_BUILDROOT_CXX=n
BR2_GCC_ENABLE_OPENMP=n

## debug

BR2_ENABLE_DEBUG=y
BR2_STRIP_strip=n
BR2_PACKAGE_HOST_GDB=y
BR2_GDB_VERSION_8_2=y

## kernel options

BR2_LINUX_KERNEL=y
#BR2_LINUX_KERNEL_LATEST_VERSION=y
BR2_LINUX_KERNEL_LATEST_CIP_VERSION=y
BR2_KERNEL_HEADERS_AS_KERNEL=y
BR2_PACKAGE_HOST_LINUX_HEADERS_CUSTOM_4_19=y
BR2_LINUX_KERNEL_USE_CUSTOM_CONFIG=y
BR2_LINUX_KERNEL_INSTALL_TARGET=y

## sysinit

BR2_ROOTFS_DEVICE_CREATION_DYNAMIC_MDEV=y
BR2_TARGET_GENERIC_ROOT_PASSWD="passwd"
BR2_SYSTEM_DHCP="eth0"

## filesystem

BR2_TARGET_ROOTFS_INITRAMFS=y
BR2_TARGET_ROOTFS_TAR=n

## software packages

BR2_PACKAGE_DROPBEAR=y
BR2_PACKAGE_DROPBEAR_SMALL=n

## configured in /kvx/Makefile
```
